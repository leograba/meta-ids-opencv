## conf/layer.conf
```bitbake
BBPATH .= ":${LAYERDIR}"

BBFILES += "${LAYERDIR}/recipes*/*/*.bb \
            ${LAYERDIR}/recipes*/*/*.bbappend \
            "

BBFILE_COLLECTIONS += "ids_camera_opencv"
BBFILE_PATTERN_ids_camera_opencv := "^${LAYERDIR}/"
BBFILE_PRIORITY_ids_camera_opencv = "20"
```
